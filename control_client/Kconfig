## control_client/Kconfig
```kconfig
config HYSIM_CONTROL_CLIENT
        tristate "Control client"
        default n
        ---help---
                Enable the control client application for sending commands to
                the hybrid control system.

if HYSIM_CONTROL_CLIENT

config HYSIM_CONTROL_CLIENT_PROGNAME
        string "Program name"
        default "control_client"
        ---help---
                This is the name of the program that will be used for the
                control client application.

config HYSIM_CONTROL_CLIENT_PRIORITY
        int "Control client task priority"
        default 100

config HYSIM_CONTROL_CLIENT_STACKSIZE
        int "Control client stack size"
        default DEFAULT_TASK_STACKSIZE

config HYSIM_CONTROL_CLIENT_INTERVAL
	int "interval"
	default 5
	---help---
		The interval at which to send TCP keep-alive probes, in seconds.

config HYSIM_CONTROL_CLIENT_NPROBES
	int "Probe count"
	default 3
	---help---
		The number of TCP keep-alive probes to send before declaring a
		connection broken.

endif
```

## pad_server/Kconfig
```kconfig
config HYSIM_PAD_SERVER
        tristate "Pad server"
        default n
        ---help---
                Enable the pad server application for controlling the hybrid
                rocket control system.

if HYSIM_PAD_SERVER

config HYSIM_PAD_SERVER_PROGNAME
        string "Program name"
        default "pad_server"
        ---help---
                This is the name of the program that will be used for the
                pad server application.

config HYSIM_PAD_SERVER_PRIORITY
        int "Pad server task priority"
        default 100

config HYSIM_PAD_SERVER_STACKSIZE
        int "Pad server stack size"
        default DEFAULT_TASK_STACKSIZE

config HYSIM_PAD_SERVER_MOCK_DATA
        bool "Use mock data instead of real sensors"
        default n

config HYSIM_PAD_SERVER_DISABLE_SENSOR_TELEMETRY
        bool "Disable sensor telemetry thread"
        default n
        ---help---
                Disable the sensor telemetry thread from starting.

config HYSIM_PAD_SERVER_DEBUG
		bool "Debug logging"
		default n
		---help---
			Enables debug logging options for the pad server

config HYSIM_PAD_SERVER_NPROBES
		int "Keep-alive `n` probes"
		default 3
		---help---
			Configures the number of probes to send for TCP keep-alive
			implementation.

config HYSIM_PAD_SERVER_INTERVAL
		int "Keep-alive interval"
		default 5
		---help---
			Configures the interval between TCP keep-alive probes in seconds.

config HYSIM_PAD_SERVER_ABORT_TIME
		int "Abort timeout"
		default 300
		---help---
			The time-out after which to abort (in seconds) if a connection is
			not re-established with the controller.

if HYSIM_PAD_SERVER_DEBUG

config HYSIM_PAD_SERVER_LOG_ERR
		bool "Debug error logging"
		default n
		---help---
			Enables error log output

config HYSIM_PAD_SERVER_LOG_WARN
		bool "Debug warning logging"
		default n
		---help---
			Enables error log output

config HYSIM_PAD_SERVER_LOG_INFO
		bool "Debug info logging"
		default n
		---help---
			Enables info log output

endif

config HYSIM_PAD_SERVER_NAU7802_KNOWN_WEIGHT
		int "The known weight in grams"
		default 1000
		---help---
			The known weight in grams for the NAU7802 sensor.

config HYSIM_PAD_SERVER_NAU7802_KNOWN_POINT
		int "The measured output of the known weight"
		default 1000

endif
```

## telem_client/Kconfig
```kconfig
config HYSIM_TELEM_CLIENT
        tristate "Telemetry client"
        default n
        ---help---
                Enable the telemetry client application for receiving telemetry
                data from the hybrid control system.

if HYSIM_TELEM_CLIENT

config HYSIM_TELEM_CLIENT_PROGNAME
        string "Program name"
        default "telem_client"
        ---help---
                This is the name of the program that will be used for the
                telemetry client application.

config HYSIM_TELEM_CLIENT_PRIORITY
        int "Telemetry client task priority"
        default 100

config HYSIM_TELEM_CLIENT_STACKSIZE
        int "Telemetry client stack size"
        default DEFAULT_TASK_STACKSIZE

endif
```
